## arch/arm64/Kconfig.exynos
```kconfig
config MACH_EXYNOS9810_R7_GLOBAL
	bool "Build Dtbo image for SM-N770"
	depends on SOC_EXYNOS9810
	default n
	help
	Say Y here if you want to enable building dtbo for Galaxy N10 Lite.
```
